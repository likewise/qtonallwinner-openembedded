## build/conf/bblayers.conf
```bitbake
# LAYER_CONF_VERSION is increased each time build/conf/bblayers.conf
# changes incompatibly
LCONF_VERSION = "7"

BBPATH = "${TOPDIR}"
BBFILES ?= ""

BBLAYERS ?= " \
  /home/leon/sandbox/sidebranch/bridgemate/openembedded/openembedded-core/meta \
  /home/leon/sandbox/sidebranch/bridgemate/openembedded/meta-openembedded/meta-oe \
  /home/leon/sandbox/sidebranch/bridgemate/openembedded/meta-qt5 \
  /home/leon/sandbox/sidebranch/bridgemate/openembedded/meta-sunxi \
  "
```
